## drivers/broadcast/Kconfig
```kconfig
#
# Broadcast Device Driver Support
#

#menu "BROADCAST_DEVICE"

config LGE_BROADCAST_TDMB
	bool "LGE broacast device"
	default n
	help
	  Select this if you want to use broadcast service
	  
#endmenu
```
